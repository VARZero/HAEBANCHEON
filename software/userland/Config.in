## software/userland/configs/haebancheon_defconfig
```kconfig
BR2_riscv=y
BR2_riscv_custom=y
BR2_RISCV_32=y
BR2_RISCV_ISA_RVM=y
BR2_RISCV_ISA_RVA=y
# BR2_RISCV_ISA_RVF is not set
# BR2_RISCV_ISA_RVD is not set
# BR2_RISCV_ISA_RVC is not set
# BR2_RISCV_ISA_RVV is not set
BR2_RISCV_ABI_ILP32=y
BR2_RISCV_USE_MMU=y
BR2_TOOLCHAIN_BUILDROOT_MUSL=y
BR2_KERNEL_HEADERS_6_12=y
BR2_GCC_VERSION_13_X=y
BR2_TOOLCHAIN_BUILDROOT_CXX=y
BR2_REPRODUCIBLE=y
BR2_TARGET_OPTIMIZATION="-O2 -march=rv32ima_zicsr_zifencei -mabi=ilp32"
BR2_TARGET_GENERIC_HOSTNAME="haebancheon"
BR2_TARGET_GENERIC_ISSUE="HAEBANCHEON development system"
BR2_INIT_BUSYBOX=y
# BR2_TARGET_GENERIC_GETTY is not set
# BR2_TARGET_GENERIC_REMOUNT_ROOTFS_RW is not set
BR2_ROOTFS_OVERLAY="$(BR2_EXTERNAL_HAEBANCHEON_PATH)/overlay"
BR2_ROOTFS_POST_BUILD_SCRIPT="$(BR2_EXTERNAL_HAEBANCHEON_PATH)/post-build.sh"
BR2_PACKAGE_BUSYBOX_SHOW_OTHERS=y
BR2_PACKAGE_VIM=y
BR2_PACKAGE_VIM_RUNTIME=y
BR2_PACKAGE_PYTHON3=y
BR2_PACKAGE_PYTHON3_PY_ONLY=y
BR2_PACKAGE_PYTHON3_ZLIB=y
BR2_PACKAGE_PYTHON3_PYEXPAT=y
BR2_PACKAGE_PYTHON3_UNICODEDATA=y
BR2_PACKAGE_PYTHON3_CODECSCJK=y
BR2_PACKAGE_PYTHON3_SQLITE=y
BR2_PACKAGE_NATIVE_GCC=y
BR2_PACKAGE_MAKE=y
BR2_TARGET_ROOTFS_EXT2=y
BR2_TARGET_ROOTFS_EXT2_4=y
BR2_TARGET_ROOTFS_EXT2_LABEL="HAEBROOT"
BR2_TARGET_ROOTFS_EXT2_SIZE="1024M"
BR2_TARGET_ROOTFS_EXT2_MKFS_OPTIONS="-O ^64bit,^metadata_csum_seed -U 862354ad-054d-4f09-94e8-232a78180931 -E lazy_itable_init=0,lazy_journal_init=0,hash_seed=862354ad-054d-4f09-94e8-232a78180931"
# BR2_TARGET_ROOTFS_TAR is not set
```

## software/userland/package/native-gcc/Config.in
```kconfig
config BR2_PACKAGE_NATIVE_GCC
	bool "HAEBANCHEON native GCC (C and C++)"
	depends on BR2_riscv && BR2_RISCV_32
	depends on BR2_TOOLCHAIN_BUILDROOT_MUSL
	depends on BR2_GCC_VERSION_13_X
	depends on BR2_INSTALL_LIBSTDCPP
	depends on BR2_USE_WCHAR
	select BR2_PACKAGE_GMP
	select BR2_PACKAGE_MPFR
	select BR2_PACKAGE_MPC
	select BR2_PACKAGE_ZLIB
	select BR2_PACKAGE_BINUTILS
	select BR2_PACKAGE_BINUTILS_TARGET
	help
	  Native RV32IMA/ILP32 GCC, using the same version and patches as
	  the host cross compiler. Development headers and runtime archives
	  are restored after Buildroot's normal target cleanup.
```
